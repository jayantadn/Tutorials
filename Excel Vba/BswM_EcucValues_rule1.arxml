AUTOSAR XML (schema 4-0-3)
package /RB/UBK/Project/EcucModuleConfigurationValuess
  module config BswM
    BswMConfig_0 (BswMConfig)
      BswMArbitration
        BswMLogicalExpression_rule1 (BswMLogicalExpression): BswMArgumentRef=BswMModeCondition_rule1
        BswMModeCondition_rule1 (BswMModeCondition): BswMConditionType=BSWM_EQUALS, BswMConditionMode=BswMModeRequestPort_rule1
          BswMConditionValue
            BswMBswMode: BswMBswRequestedMode=COMM_FULL_COMMUNICATION
        BswMModeRequestPort_rule1 (BswMModeRequestPort): BswMReqModeUndefAfterInit=false
          BswMModeRequestSource
            BswMGenericRequest: BswMModeRequesterId=0, BswMRequestedModeMax=0
        BswMRule_rule1 (BswMRule): BswMNestedExecutionOnly=false, BswMRuleInitState=BSWM_UNDEFINED
      BswMModeControl
        BswMAction_rule1 (BswMAction)
          BswMAvailableActions
            BswMUserCallout: BswMUserCalloutFunction=UserCallout_AllowCom()
